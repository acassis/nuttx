## nuttx/fs/Kconfig
```kconfig
#
# For a description of the syntax of this configuration file,
# see misc/tools/kconfig-language.txt.
#

comment "File system configuration"

config DISABLE_MOUNTPOINT
	bool "Disable support for mount points"
	default n

config FS_AUTOMOUNTER
	bool "Auto-mounter"
	default n
	depends on !DISABLE_MOUNTPOINT
	---help---
		The automounter provides an OS-internal mechanism for automatically
		mounting and unmounting removable media as the media is inserted and
		removed.  See include/nuttx/fs/automout.h for interfacing details.

config FS_AUTOMOUNTER_DEBUG
	bool "Auto-mounter debug"
	default n
	depends on FS_AUTOMOUNTER && DEBUG
	---help---
		Normally, the auto-mounter will generate debug output when sub-system
		level file system debug is enabled.  This option will select debug
		output from the logic related to the auto-mount feature even when file
		system debug is not enable.  This is useful primarily for in vivo
		unit testing of the auto-mount feature.

config DISABLE_PSEUDOFS_OPERATIONS
	bool "Disable pseudo-filesystem operations"
	default y if DEFAULT_SMALL
	default n if !DEFAULT_SMALL
	---help---
		Disable certain operations on pseudo-file systems include mkdir,
		rmdir, unlink, and rename.  These are necessary for the logical
		completeness of the illusion created by the pseudo-filesystem.
		However, in practical embedded system, they are seldom needed and
		you can save a little FLASH space by disabling the capability.

config FS_READABLE
	bool
	default n

config FS_WRITABLE
	bool
	default n

source fs/aio/Kconfig
source fs/semaphore/Kconfig
source fs/mqueue/Kconfig
source fs/shm/Kconfig
source fs/mmap/Kconfig
source fs/fat/Kconfig
source fs/nfs/Kconfig
source fs/nxffs/Kconfig
source fs/romfs/Kconfig
source fs/smartfs/Kconfig
source fs/binfs/Kconfig
source fs/procfs/Kconfig

comment "System Logging"

config SYSLOG
	bool "Advanced SYSLOG features"
	default n
	---help---
		Enables generic system logging features.  NOTE: This setting is not
		required to enable system logging.  If this feature is not enable
		system logging will still be available and will log to the system
		console (like printf()).  This setting is required to enable
		customization of the basic system loggin capability.

if SYSLOG

config SYSLOG_TIMESTAMP
	bool "Prepend timestamp to syslog message"
	default n
	---help---
		Prepend timestamp to syslog message.

config SYSLOG_PRIORITY
	bool "Prepend log priority level to syslog message"
	default y
	---help---
		Prepend log priority level to syslog message.

config SYSLOG_COLOR
	bool "Add color in syslog message."
	default n
	---help---
		Use ANSI ESC sequence to color log message.

if SYSLOG_COLOR

choice
	prompt "EMERG text color"
	default SYSLOG_COLOR_EMERG_TEXT_WHITE

config SYSLOG_COLOR_EMERG_TEXT_BLACK  
	bool "Black"

config SYSLOG_COLOR_EMERG_TEXT_RED    
	bool "Red"

config SYSLOG_COLOR_EMERG_TEXT_GREEN  
	bool "Green"

config SYSLOG_COLOR_EMERG_TEXT_YELLOW 
	bool "Yellow"

config SYSLOG_COLOR_EMERG_TEXT_BLUE   
	bool "Blue"

config SYSLOG_COLOR_EMERG_TEXT_MAGENTA
	bool "Magenta"

config SYSLOG_COLOR_EMERG_TEXT_CYAN   
	bool "Cyan"

config SYSLOG_COLOR_EMERG_TEXT_WHITE  
	bool "White"

config SYSLOG_COLOR_EMERG_TEXT_DEFAULT
	bool "Default"

endchoice # EMERG Text Color

choice
	prompt "EMERG background color"
	default SYSLOG_COLOR_EMERG_BACK_RED

config SYSLOG_COLOR_EMERG_BACK_BLACK  
	bool "Black"

config SYSLOG_COLOR_EMERG_BACK_RED    
	bool "Red"

config SYSLOG_COLOR_EMERG_BACK_GREEN  
	bool "Green"

config SYSLOG_COLOR_EMERG_BACK_YELLOW 
	bool "Yellow"

config SYSLOG_COLOR_EMERG_BACK_BLUE   
	bool "Blue"

config SYSLOG_COLOR_EMERG_BACK_MAGENTA
	bool "Magenta"

config SYSLOG_COLOR_EMERG_BACK_CYAN   
	bool "Cyan"

config SYSLOG_COLOR_EMERG_BACK_WHITE  
	bool "White"

config SYSLOG_COLOR_EMERG_BACK_DEFAULT
	bool "Default"

endchoice # EMERG Background Color

choice
	prompt "ALERT text color"
	default SYSLOG_COLOR_ALERT_TEXT_YELLOW

config SYSLOG_COLOR_ALERT_TEXT_BLACK  
	bool "Black"

config SYSLOG_COLOR_ALERT_TEXT_RED    
	bool "Red"

config SYSLOG_COLOR_ALERT_TEXT_GREEN  
	bool "Green"

config SYSLOG_COLOR_ALERT_TEXT_YELLOW 
	bool "Yellow"

config SYSLOG_COLOR_ALERT_TEXT_BLUE   
	bool "Blue"

config SYSLOG_COLOR_ALERT_TEXT_MAGENTA
	bool "Magenta"

config SYSLOG_COLOR_ALERT_TEXT_CYAN   
	bool "Cyan"

config SYSLOG_COLOR_ALERT_TEXT_WHITE  
	bool "White"

config SYSLOG_COLOR_ALERT_TEXT_DEFAULT
	bool "Default"

endchoice # ALERT Text Color

choice
	prompt "ALERT background color"
	default SYSLOG_COLOR_ALERT_BACK_RED

config SYSLOG_COLOR_ALERT_BACK_BLACK  
	bool "Black"

config SYSLOG_COLOR_ALERT_BACK_RED    
	bool "Red"

config SYSLOG_COLOR_ALERT_BACK_GREEN  
	bool "Green"

config SYSLOG_COLOR_ALERT_BACK_YELLOW 
	bool "Yellow"

config SYSLOG_COLOR_ALERT_BACK_BLUE   
	bool "Blue"

config SYSLOG_COLOR_ALERT_BACK_MAGENTA
	bool "Magenta"

config SYSLOG_COLOR_ALERT_BACK_CYAN   
	bool "Cyan"

config SYSLOG_COLOR_ALERT_BACK_WHITE  
	bool "White"

config SYSLOG_COLOR_ALERT_BACK_DEFAULT
	bool "Default"

endchoice # ALERT Background Color

choice
	prompt "CRITICAL text color"
	default SYSLOG_COLOR_CRITICAL_TEXT_BLACK

config SYSLOG_COLOR_CRITICAL_TEXT_BLACK  
	bool "Black"

config SYSLOG_COLOR_CRITICAL_TEXT_RED    
	bool "Red"

config SYSLOG_COLOR_CRITICAL_TEXT_GREEN  
	bool "Green"

config SYSLOG_COLOR_CRITICAL_TEXT_YELLOW 
	bool "Yellow"

config SYSLOG_COLOR_CRITICAL_TEXT_BLUE   
	bool "Blue"

config SYSLOG_COLOR_CRITICAL_TEXT_MAGENTA
	bool "Magenta"

config SYSLOG_COLOR_CRITICAL_TEXT_CYAN   
	bool "Cyan"

config SYSLOG_COLOR_CRITICAL_TEXT_WHITE  
	bool "White"

config SYSLOG_COLOR_CRITICAL_TEXT_DEFAULT
	bool "Default"

endchoice # CRITICAL Text Color

choice
	prompt "CRITICAL background color"
	default SYSLOG_COLOR_CRITICAL_BACK_RED

config SYSLOG_COLOR_CRITICAL_BACK_BLACK  
	bool "Black"

config SYSLOG_COLOR_CRITICAL_BACK_RED    
	bool "Red"

config SYSLOG_COLOR_CRITICAL_BACK_GREEN  
	bool "Green"

config SYSLOG_COLOR_CRITICAL_BACK_YELLOW 
	bool "Yellow"

config SYSLOG_COLOR_CRITICAL_BACK_BLUE   
	bool "Blue"

config SYSLOG_COLOR_CRITICAL_BACK_MAGENTA
	bool "Magenta"

config SYSLOG_COLOR_CRITICAL_BACK_CYAN   
	bool "Cyan"

config SYSLOG_COLOR_CRITICAL_BACK_WHITE  
	bool "White"

config SYSLOG_COLOR_CRITICAL_BACK_DEFAULT
	bool "Default"

endchoice # CRITICAL Background Color

choice
	prompt "ERROR text color"
	default SYSLOG_COLOR_ERROR_TEXT_RED

config SYSLOG_COLOR_ERROR_TEXT_BLACK  
	bool "Black"

config SYSLOG_COLOR_ERROR_TEXT_RED    
	bool "Red"

config SYSLOG_COLOR_ERROR_TEXT_GREEN  
	bool "Green"

config SYSLOG_COLOR_ERROR_TEXT_YELLOW 
	bool "Yellow"

config SYSLOG_COLOR_ERROR_TEXT_BLUE   
	bool "Blue"

config SYSLOG_COLOR_ERROR_TEXT_MAGENTA
	bool "Magenta"

config SYSLOG_COLOR_ERROR_TEXT_CYAN   
	bool "Cyan"

config SYSLOG_COLOR_ERROR_TEXT_WHITE  
	bool "White"

config SYSLOG_COLOR_ERROR_TEXT_DEFAULT
	bool "Default"

endchoice # ERROR Text Color

choice
	prompt "ERROR background color"
	default SYSLOG_COLOR_ERROR_BACK_BLACK

config SYSLOG_COLOR_ERROR_BACK_BLACK  
	bool "Black"

config SYSLOG_COLOR_ERROR_BACK_RED    
	bool "Red"

config SYSLOG_COLOR_ERROR_BACK_GREEN  
	bool "Green"

config SYSLOG_COLOR_ERROR_BACK_YELLOW 
	bool "Yellow"

config SYSLOG_COLOR_ERROR_BACK_BLUE   
	bool "Blue"

config SYSLOG_COLOR_ERROR_BACK_MAGENTA
	bool "Magenta"

config SYSLOG_COLOR_ERROR_BACK_CYAN   
	bool "Cyan"

config SYSLOG_COLOR_ERROR_BACK_WHITE  
	bool "White"

config SYSLOG_COLOR_ERROR_BACK_DEFAULT
	bool "Default"

endchoice # ERROR Background Color

choice
	prompt "WARNING text color"
	default SYSLOG_COLOR_WARNING_TEXT_YELLOW

config SYSLOG_COLOR_WARNING_TEXT_BLACK  
	bool "Black"

config SYSLOG_COLOR_WARNING_TEXT_RED    
	bool "Red"

config SYSLOG_COLOR_WARNING_TEXT_GREEN  
	bool "Green"

config SYSLOG_COLOR_WARNING_TEXT_YELLOW 
	bool "Yellow"

config SYSLOG_COLOR_WARNING_TEXT_BLUE   
	bool "Blue"

config SYSLOG_COLOR_WARNING_TEXT_MAGENTA
	bool "Magenta"

config SYSLOG_COLOR_WARNING_TEXT_CYAN   
	bool "Cyan"

config SYSLOG_COLOR_WARNING_TEXT_WHITE  
	bool "White"

config SYSLOG_COLOR_WARNING_TEXT_DEFAULT
	bool "Default"

endchoice # WARNING Text Color

choice
	prompt "WARNING background color"
	default SYSLOG_COLOR_WARNING_BACK_BLACK

config SYSLOG_COLOR_WARNING_BACK_BLACK  
	bool "Black"

config SYSLOG_COLOR_WARNING_BACK_RED    
	bool "Red"

config SYSLOG_COLOR_WARNING_BACK_GREEN  
	bool "Green"

config SYSLOG_COLOR_WARNING_BACK_YELLOW 
	bool "Yellow"

config SYSLOG_COLOR_WARNING_BACK_BLUE   
	bool "Blue"

config SYSLOG_COLOR_WARNING_BACK_MAGENTA
	bool "Magenta"

config SYSLOG_COLOR_WARNING_BACK_CYAN   
	bool "Cyan"

config SYSLOG_COLOR_WARNING_BACK_WHITE  
	bool "White"

config SYSLOG_COLOR_WARNING_BACK_DEFAULT
	bool "Default"

endchoice # WARNING Background Color

choice
	prompt "NOTICE text color"
	default SYSLOG_COLOR_NOTICE_TEXT_GREEN

config SYSLOG_COLOR_NOTICE_TEXT_BLACK  
	bool "Black"

config SYSLOG_COLOR_NOTICE_TEXT_RED    
	bool "Red"

config SYSLOG_COLOR_NOTICE_TEXT_GREEN  
	bool "Green"

config SYSLOG_COLOR_NOTICE_TEXT_YELLOW 
	bool "Yellow"

config SYSLOG_COLOR_NOTICE_TEXT_BLUE   
	bool "Blue"

config SYSLOG_COLOR_NOTICE_TEXT_MAGENTA
	bool "Magenta"

config SYSLOG_COLOR_NOTICE_TEXT_CYAN   
	bool "Cyan"

config SYSLOG_COLOR_NOTICE_TEXT_WHITE  
	bool "White"

config SYSLOG_COLOR_NOTICE_TEXT_DEFAULT
	bool "Default"

endchoice # NOTICE Text Color

choice
	prompt "NOTICE background color"
	default SYSLOG_COLOR_NOTICE_BACK_BLACK

config SYSLOG_COLOR_NOTICE_BACK_BLACK  
	bool "Black"

config SYSLOG_COLOR_NOTICE_BACK_RED    
	bool "Red"

config SYSLOG_COLOR_NOTICE_BACK_GREEN  
	bool "Green"

config SYSLOG_COLOR_NOTICE_BACK_YELLOW 
	bool "Yellow"

config SYSLOG_COLOR_NOTICE_BACK_BLUE   
	bool "Blue"

config SYSLOG_COLOR_NOTICE_BACK_MAGENTA
	bool "Magenta"

config SYSLOG_COLOR_NOTICE_BACK_CYAN   
	bool "Cyan"

config SYSLOG_COLOR_NOTICE_BACK_WHITE  
	bool "White"

config SYSLOG_COLOR_NOTICE_BACK_DEFAULT
	bool "Default"

endchoice # NOTICE Background Color

choice
	prompt "INFO text color"
	default SYSLOG_COLOR_INFO_TEXT_CYAN

config SYSLOG_COLOR_INFO_TEXT_BLACK  
	bool "Black"

config SYSLOG_COLOR_INFO_TEXT_RED    
	bool "Red"

config SYSLOG_COLOR_INFO_TEXT_GREEN  
	bool "Green"

config SYSLOG_COLOR_INFO_TEXT_YELLOW 
	bool "Yellow"

config SYSLOG_COLOR_INFO_TEXT_BLUE   
	bool "Blue"

config SYSLOG_COLOR_INFO_TEXT_MAGENTA
	bool "Magenta"

config SYSLOG_COLOR_INFO_TEXT_CYAN   
	bool "Cyan"

config SYSLOG_COLOR_INFO_TEXT_WHITE  
	bool "White"

config SYSLOG_COLOR_INFO_TEXT_DEFAULT
	bool "Default"

endchoice # INFO Text Color

choice
	prompt "INFO background color"
	default SYSLOG_COLOR_INFO_BACK_BLACK

config SYSLOG_COLOR_INFO_BACK_BLACK  
	bool "Black"

config SYSLOG_COLOR_INFO_BACK_RED    
	bool "Red"

config SYSLOG_COLOR_INFO_BACK_GREEN  
	bool "Green"

config SYSLOG_COLOR_INFO_BACK_YELLOW 
	bool "Yellow"

config SYSLOG_COLOR_INFO_BACK_BLUE   
	bool "Blue"

config SYSLOG_COLOR_INFO_BACK_MAGENTA
	bool "Magenta"

config SYSLOG_COLOR_INFO_BACK_CYAN   
	bool "Cyan"

config SYSLOG_COLOR_INFO_BACK_WHITE  
	bool "White"

config SYSLOG_COLOR_INFO_BACK_DEFAULT
	bool "Default"

endchoice # INFO Background Color

choice
	prompt "DEBUG text color"
	default SYSLOG_COLOR_DEBUG_TEXT_WHITE

config SYSLOG_COLOR_DEBUG_TEXT_BLACK  
	bool "Black"

config SYSLOG_COLOR_DEBUG_TEXT_RED    
	bool "Red"

config SYSLOG_COLOR_DEBUG_TEXT_GREEN  
	bool "Green"

config SYSLOG_COLOR_DEBUG_TEXT_YELLOW 
	bool "Yellow"

config SYSLOG_COLOR_DEBUG_TEXT_BLUE   
	bool "Blue"

config SYSLOG_COLOR_DEBUG_TEXT_MAGENTA
	bool "Magenta"

config SYSLOG_COLOR_DEBUG_TEXT_CYAN   
	bool "Cyan"

config SYSLOG_COLOR_DEBUG_TEXT_WHITE  
	bool "White"

config SYSLOG_COLOR_DEBUG_TEXT_DEFAULT
	bool "Default"

endchoice # DEBUG Text Color

choice
	prompt "DEBUG background color"
	default SYSLOG_COLOR_DEBUG_BACK_BLACK

config SYSLOG_COLOR_DEBUG_BACK_BLACK  
	bool "Black"

config SYSLOG_COLOR_DEBUG_BACK_RED    
	bool "Red"

config SYSLOG_COLOR_DEBUG_BACK_GREEN  
	bool "Green"

config SYSLOG_COLOR_DEBUG_BACK_YELLOW 
	bool "Yellow"

config SYSLOG_COLOR_DEBUG_BACK_BLUE   
	bool "Blue"

config SYSLOG_COLOR_DEBUG_BACK_MAGENTA
	bool "Magenta"

config SYSLOG_COLOR_DEBUG_BACK_CYAN   
	bool "Cyan"

config SYSLOG_COLOR_DEBUG_BACK_WHITE  
	bool "White"

config SYSLOG_COLOR_DEBUG_BACK_DEFAULT
	bool "Default"

endchoice # DEBUG Background Color

endif

config SYSLOG_CHAR
	bool "System log character device support"
	default y
	---help---
		Enable the generic character device for the SYSLOG. The full path to the
		SYSLOG device is provided by SYSLOG_DEVPATH. A valid character device (or
		file) must exist at this path.  It will by opened by syslog_initialize.

		Do not enable more than one SYSLOG device.

config SYSLOG_DEVPATH
	string "System log device"
	default "/dev/syslog"
	depends on SYSLOG_CHAR
	---help---
		The full path to the system logging device.  For the RAMLOG SYSLOG device,
		this is normally "/dev/ramlog".  For character SYSLOG devices, it should be
		some other existing character device (or file) supported by the configuration
		(such as "/dev/ttyS1")/

endif
```

## nuttx/arch/arm/src/efm32/Kconfig
```kconfig
#
# arch/arm/src/efm32/Kconfig
#

if ARCH_CHIP_EFM32

comment "EFM32 Configuration Options"

choice
	prompt "EFM32 Chip Selection"
	default ARCH_CHIP_EFM32TG840F32

config ARCH_CHIP_EFM32TG840F32
	bool "EFM32TG840F32"
	select ARCH_CORTEXM3
	---help---
		This chip is a Tiny Gecko with 32 KB flash
		and 4 KB RAM in a QFN64 package

config ARCH_CHIP_EFM32GG332F1024
	bool "EFM32GG332F1024"
	select ARCH_CORTEXM3
	---help---
		This chip is a Giant Gecko with 1024 KB flash
		and 128 KB RAM in a QFP64 package
		Planned but not done yet ! 

endchoice


config GPIO_IRQ_DISPATCHER
	bool "GPIO interrupts dispatch"
	---help---
		Enable dispatcher for interrupting GPIO pins

config EFM32_GPIO_KEYPAD
	bool "Key pad on GPIO mapped to keyboard"
	---help---
		Enable keypad with GPIO pins

config EFM32_SPI_NBR
	int "SPI driver number max"
	default 1
	---help---
		You need to Enable also DRIVERS->SPI.

endif
```

## nuttx/arch/arm/src/efm32tg/Kconfig
```kconfig
#
# arch/arm/src/efm32/Kconfig
#

if ARCH_CHIP_EFM32

comment "EFM32 Configuration Options"

choice
	prompt "EFM32 Chip Selection"
	default ARCH_CHIP_EFM32LG990F256

config ARCH_CHIP_EFM32LG232F128
	bool "EFM32LG232F128"
	select ARCH_CORTEXM3
	---help---
		This chip is a Leopard Gecko with 128 KB flash
		and 32 KB RAM in a QFP64 package

config ARCH_CHIP_EFM32LG990F256
	bool "EFM32LG990F256"
	select ARCH_CORTEXM3
	---help---
		This chip is a Leopard Gecko with 256 KB flash
		and 32 KB RAM in a BGA112 package.

config ARCH_CHIP_EFM32GG990F1024
	bool "EFM32GG990F1024"
	select ARCH_CORTEXM3
	---help---
		This chip is a Giant Gecko with 1024 KB flash
		and 128 KB RAM in a BGA112 package.

config ARCH_CHIP_EFM32GG330F1024
	bool "EFM32GG330F1024"
	select ARCH_CORTEXM3
	---help---
		This chip is a Giant Gecko with 1024 KB flash
		and 128 KB RAM in a QFP64 package.

endchoice

endif
```

## nuttx/configs/efm32gg-pnbfano/Kconfig
```kconfig
#
# For a description of the syntax of this configuration file,
# see misc/tools/kconfig-language.txt.
#

if ARCH_BOARD_EFM32GG_PNBFANO

choice
    prompt  PNBFANO_BOARD
	default PNBFANO_BOARD_V1

config PNBFANO_BOARD_V1
	bool "PnbFano board V1"

endchoice

menu "EFM32 PNBFANO Hardware Configuration"

config PNBFANO_GPIO_KEYPAD
	bool "PNBFANO GPIO keypad Driver"
    select ARCH_BUTTONS
    select EFM32_GPIO_IRQ
    select LIB_KBDCODEC
    select BOARD_INITIALIZE
	depends on ARCH_CHIP_EFM32
	default n if PNBFANO_BOARD_V1
	---help---
		Enables support for keypad on gpio.

config PNBFANO_GPIO_PPS
	bool "PNBFANO GPIO PPS Driver"
    select ARCH_BUTTONS
    select EFM32_GPIO_IRQ
    select BOARD_INITIALIZE
	depends on ARCH_CHIP_EFM32
	default n if PNBFANO_BOARD_V1
	---help---
		Enables support for PPS on gpio.

config PNBFANO_GPIO_CHRONO
	bool "PNBFANO GPIO CHRONO Driver"
    select ARCH_BUTTONS
    select EFM32_GPIO_IRQ
    select BOARD_INITIALIZE
	depends on ARCH_CHIP_EFM32
	default n if PNBFANO_BOARD_V1
	---help---
		Enables support for chrono on gpio.

config PNBFANO_LCD_KEYPAD
	bool "EFM32 keypad using LCD bus Driver"
    select ARCH_BUTTONS
    select LIB_KBDCODEC
    select BOARD_INITIALIZE
	depends on ARCH_CHIP_EFM32
	default y if PNBFANO_BOARD_V1
	---help---
		Enables support for keypad on LCD bus.

config PNBFANO_USE_MMCSD
	bool "Enable MMCSD support Driver"
    select BOARD_INITIALIZE
    select MMCSD
    select MMCSD_SPI
	depends on ARCH_CHIP_EFM32
	default y if PNBFANO_BOARD_V1
	---help---
		Enables support for SD card on gpio.

config PNBFANO_USE_CC3000
	bool "Enable CC3000 support Driver"
    select BOARD_INITIALIZE
	depends on ARCH_CHIP_EFM32
	default y if PNBFANO_BOARD_V1
	---help---
		Enables support for CC3000 extension.

config PNBFANO_BOARD_VPLANE
	int "Video Plane"
	int 
	default 0 if PNBFANO_BOARD_V1
	---help---
		The plane to select from the framebuffer driver for use in the test.
		Default: 0

config PNBFANO_BOARD_DEVNO
	int "Video Device Number"
	int 
	default 0 if PNBFANO_BOARD_V1
	---help---
		The LCD device to select from the LCD driver for use in the test:
		Default: 0

config PNBFANO_BOARD_BPP
	int "Bits-Per-Pixel"
	int 
	default 1 if PNBFANO_BOARD_V1
	---help---
		Pixels per pixel to use.  Valid options include 1, 2, 4, 8, 16, 24,
		and 32.  Default is 32.

config PNBFANO_AUTO_USBDEV_MSC
	bool "Enable Automatic usbmsc."
	depends on USBDEV
	default y if PNBFANO_BOARD_V1
	---help---
		Enables automatic enable/disable usbmsc on usb connection/disconnection
		of usb cable.


endmenu

endif
```

## nuttx/configs/efm32tg-stk3300/Kconfig
```kconfig
#
# For a description of the syntax of this configuration file,
# see misc/tools/kconfig-language.txt.
#

if ARCH_BOARD_EFM32TG_STK3300

comment "EFM32 STK3300 Hardware Configuration"

config EFM32_SWO_LOCATION
	int "Swo location output"
	default 1
	---help---
		Select with location of SWO pin.

config EFM32_SWO_DIV
	int "Swo divider output (=14Mhz/x)"
	default 16
	---help---
		Choose SWO speed by set divider.
		SWO speed is 14Mhz/(swo_divider).

endif
```

## nuttx/drivers/sensors/Kconfig
```kconfig
#
# For a description of the syntax of this configuration file,
# see misc/tools/kconfig-language.txt.
#

config LIS331DL
	bool "ST LIS331DL device support"
	default n
	select I2C

config MPL115A
	bool "Freescale MPL115A Barometer Sensor support"
	default n
	select SPI
	---help---
		Enable driver support for the Freescale MPL115A barometer sensor.

config SENSORS_ADXL345
	bool "AnalogDevices ADXL345 Driver"
	default n
	---help---
		Enables support for the ADXL345 driver

if SENSORS_ADXL345

choice
	prompt "ADXL345 Interface"
	default ADXL345_SPI

config ADXL345_SPI
	bool "ADXL345 SPI Interface"
	select SPI
	---help---
		Enables support for the SPI interface.

config ADXL345_I2C
	bool "ADXL345 I2C Interface"
	select I2C
	---help---
		Enables support for the I2C interface

endchoice

config ADXL345_ACTIVELOW
	bool "Active Low Interrupt"
	default n
	---help---
		The ADXL345 interrupt will be inverted. Instead starting low and going
		high, it will start high and will go low when an interrupt is fired.
		Default:  Active high/rising edge.

config ADXL345_REGDEBUG
	bool "Enable Register-Level ADXL345 Debug"
	default n
	depends on DEBUG
	---help---
		Enable very low register-level debug output.

endif # SENSORS_ADXL345

config I2C_LM75
	bool
	default y if LM75

config LM75
	bool "STMicro LM-75 Temperature Sensor support"
	default n
	select I2C
	select I2C_LM75
	---help---
		Enable driver support for the STMicro LM-75 temperature sensor.
		This should also work with compatible temperature sensors such as
		the TI TMP100/101.

config QENCODER
	bool "Qencoder"
	default n

config SENSORS_INVENSENSE
	bool "Invensense MPU9250 Driver (9Axes sensors)"
	default n
	---help---
		Enables support for the Invensense motion sensors driver.
		accelerometer,gyroscope and Magnetometer axes.
		This is a device that in integrate:accelerometer.
		MPU6050                                            
		MPU6500 
		MPU9150 (or MPU6050 w/ AK8975 on the auxiliary bus)
		MPU9250 (or MPU6500 w/ AK8963 on the auxiliary bus)

if SENSORS_INVENSENSE

choice
	prompt "Invensense IC"
	default SENSOR_MPU9250

config SENSOR_MPU6050
	bool "Invensense MPU6050 Driver (6Axes sensors)"
	select INVENSENSE_I2C
	default n
	---help---
		Enables support for the MPU9250 driver.

config SENSOR_MPU6500
	bool "Invensense MPU6500 Driver (6Axes sensors)"
	select INVENSENSE_I2C
	default n
	---help---
		Enables support for the MPU6500 driver.

config SENSOR_MPU9150
	bool "Invensense MPU9150 Driver (9Axes sensors)"
	select INVENSENSE_I2C
	default n
	---help---
		Enables support for the MPU9150 driver.
		like a MPU6050 with AK8975 on the auxiliary bus.

config SENSOR_MPU9250
	bool "Invensense MPU9250 Driver (9Axes sensors)"
	default n
	---help---
		Enables support for the MPU9250 driver.
		like a MPU6500 with AK8963 on the auxiliary bus.

endchoice

choice
	prompt "MPU9250 Interface"
	default MPU9250_I2C

config INVENSENSE_SPI
	bool "Invensense SPI Interface"
	select SPI
	---help---
		Enables support for the SPI interface.

config INVENSENSE_I2C
	bool "Invensense I2C Interface"
	select I2C
	---help---
		Enables support for the I2C interface

endchoice

config INVENSENSE_DMP
	bool "Enable Invensense motion Driver (DMP)."
	default n
	---help---
		Enables support of motion coprocessor driver.

config INVENSENSE_DEBUG
	bool "Enable Invensense debug."
	default n
	---help---
		Enables debug of Invensense driver.

endif # SENSORS
```
